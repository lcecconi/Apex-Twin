#pragma once

#include <Arduino.h>
#include <U8g2lib.h>

/**
 * Apex-Dash Icon Library
 * Monochrome XBM pixel bitmaps (16x16) and procedural gauges for U8g2.
 */

// =========================================================================
// 1. MENU ICONS (16x16 px)
// =========================================================================

// Race & Kart Setup (Steering Wheel / Kart)
static const unsigned char icon_kart_16[] PROGMEM = {
  0x00, 0x00, 0xe0, 0x07, 0x18, 0x18, 0x04, 0x20, 0x02, 0x40, 0x32, 0x4c,
  0x7a, 0x5e, 0xfa, 0x5f, 0x72, 0x4e, 0x02, 0x40, 0x04, 0x20, 0x08, 0x10,
  0x10, 0x08, 0xe0, 0x07, 0x00, 0x00, 0x00, 0x00
};

// LEDs & Shift Alarms (Lightbulb)
static const unsigned char icon_led_16[] PROGMEM = {
  0x00, 0x00, 0x80, 0x01, 0xc0, 0x03, 0xe0, 0x07, 0xf0, 0x0f, 0xf8, 0x1f,
  0xf8, 0x1f, 0xf8, 0x1f, 0xf0, 0x0f, 0xe0, 0x07, 0x40, 0x02, 0xe0, 0x07,
  0x40, 0x02, 0xc0, 0x03, 0x00, 0x00, 0x00, 0x00
};

// Track & GPS Database (Checkered Flag)
static const unsigned char icon_flag_16[] PROGMEM = {
  0x00, 0x00, 0x18, 0x00, 0x18, 0x3c, 0x18, 0x66, 0x18, 0xc3, 0x18, 0xdb,
  0x18, 0xdb, 0x18, 0x66, 0x18, 0x3c, 0x18, 0x00, 0x18, 0x00, 0x18, 0x00,
  0x18, 0x00, 0x3c, 0x00, 0x00, 0x00, 0x00, 0x00
};

// Storage & PC Mass Storage (MicroSD Card)
static const unsigned char icon_sd_16[] PROGMEM = {
  0x00, 0x00, 0xfe, 0x3f, 0x02, 0x20, 0xda, 0x2a, 0xda, 0x2a, 0x02, 0x20,
  0x02, 0x20, 0x02, 0x20, 0x02, 0x20, 0x02, 0x20, 0x02, 0x20, 0x02, 0x20,
  0x02, 0x20, 0xfe, 0x3f, 0x00, 0x00, 0x00, 0x00
};

// Display & Backlight PWM (Sun / Contrast)
static const unsigned char icon_display_16[] PROGMEM = {
  0x00, 0x00, 0x80, 0x01, 0x00, 0x00, 0x88, 0x11, 0xe0, 0x07, 0xf0, 0x0f,
  0xf8, 0x1f, 0x21, 0x84, 0xf8, 0x1f, 0xf0, 0x0f, 0xe0, 0x07, 0x88, 0x11,
  0x00, 0x00, 0x80, 0x01, 0x00, 0x00, 0x00, 0x00
};

// System & Language (Globe)
static const unsigned char icon_globe_16[] PROGMEM = {
  0x00, 0x00, 0xe0, 0x07, 0x18, 0x18, 0x24, 0x24, 0x42, 0x42, 0xff, 0xff,
  0x42, 0x42, 0x42, 0x42, 0xff, 0xff, 0x42, 0x42, 0x24, 0x24, 0x18, 0x18,
  0xe0, 0x07, 0x00, 0x00, 0x00, 0x00, 0x00, 0x00
};

// Hardware Diagnostics (Wrench)
static const unsigned char icon_wrench_16[] PROGMEM = {
  0x00, 0x00, 0x70, 0x00, 0xd8, 0x01, 0x88, 0x03, 0x10, 0x07, 0x30, 0x0e,
  0x60, 0x1c, 0xc0, 0x38, 0x80, 0x71, 0x00, 0xe3, 0x00, 0xc7, 0x00, 0x8e,
  0x00, 0x1c, 0x00, 0x38, 0x00, 0x30, 0x00, 0x00
};

// Exit / Back (Door & Arrow)
static const unsigned char icon_exit_16[] PROGMEM = {
  0x00, 0x00, 0xfe, 0x3f, 0x02, 0x20, 0x02, 0x20, 0x02, 0x20, 0x82, 0x21,
  0xc2, 0x23, 0xfe, 0x3f, 0xc2, 0x23, 0x82, 0x21, 0x02, 0x20, 0x02, 0x20,
  0x02, 0x20, 0xfe, 0x3f, 0x00, 0x00, 0x00, 0x00
};

// =========================================================================
// 2. LIVE RACE ALARM & SENSOR ICONS (16x16 px)
// =========================================================================

// Coolant Overheat Thermometer Alarm
static const unsigned char icon_temp_16[] PROGMEM = {
  0x00, 0x00, 0x70, 0x00, 0x88, 0x00, 0xa8, 0x02, 0x88, 0x00, 0xa8, 0x02,
  0x88, 0x00, 0xa8, 0x02, 0xd8, 0x01, 0xfc, 0x03, 0xfc, 0x03, 0xfc, 0x03,
  0xd8, 0x01, 0x70, 0x00, 0x00, 0x00, 0x00, 0x00
};

// Exhaust Gas Temperature (EGT) Flame Alarm
static const unsigned char icon_egt_16[] PROGMEM = {
  0x00, 0x00, 0x20, 0x00, 0x70, 0x00, 0xf8, 0x00, 0xf8, 0x01, 0xfc, 0x03,
  0xfe, 0x07, 0xfe, 0x0f, 0xfe, 0x0f, 0xfe, 0x0f, 0xfc, 0x07, 0xf8, 0x03,
  0xf0, 0x01, 0x60, 0x00, 0x00, 0x00, 0x00, 0x00
};

// Shift RPM Rocket Warning
static const unsigned char icon_shift_16[] PROGMEM = {
  0x00, 0x00, 0x80, 0x01, 0xc0, 0x03, 0xe0, 0x07, 0xf0, 0x0f, 0xf8, 0x1f,
  0xbc, 0x3d, 0x9c, 0x39, 0xcc, 0x33, 0xe8, 0x17, 0x70, 0x0e, 0x20, 0x04,
  0x50, 0x0a, 0x20, 0x04, 0x00, 0x00, 0x00, 0x00
};

// GPS Satellite Fix
static const unsigned char icon_sat_16[] PROGMEM = {
  0x00, 0x00, 0x03, 0x00, 0x07, 0x00, 0x0e, 0x30, 0x1c, 0x78, 0x38, 0xdc,
  0x70, 0x8e, 0xe0, 0x07, 0x71, 0x0e, 0x3b, 0x1c, 0x1e, 0x38, 0x0c, 0x70,
  0x00, 0xe0, 0x00, 0xc0, 0x00, 0x00, 0x00, 0x00
};

// =========================================================================
// 3. PROCEDURAL GAUGES & STATUS BADGES
// =========================================================================

class IconRenderer {
public:
  /**
   * Draw dynamic battery gauge with charge level bars and nipple.
   */
  static void drawBattery(U8G2 *u8g2, int x, int y, float voltage, uint8_t percent) {
    // Battery Frame: 22 x 11 px
    u8g2->drawFrame(x, y, 20, 11);
    u8g2->drawBox(x + 20, y + 3, 2, 5); // Nipple (+)

    // Fill bars (0 to 3 internal segments)
    int fill_w = (percent * 16) / 100;
    if (fill_w > 16) fill_w = 16;
    if (fill_w > 0) {
      u8g2->drawBox(x + 2, y + 2, fill_w, 7);
    }
  }

  /**
   * Draw 4-bar wireless RF signal strength indicator.
   */
  static void drawSignalBars(U8G2 *u8g2, int x, int y, int rssi, bool connected) {
    if (!connected) {
      // Disconnected: Draw 'X'
      u8g2->drawLine(x, y + 2, x + 12, y + 12);
      u8g2->drawLine(x + 12, y + 2, x, y + 12);
      return;
    }

    int bars = (rssi > -60) ? 4 : ((rssi > -72) ? 3 : ((rssi > -82) ? 2 : 1));
    for (int i = 0; i < 4; i++) {
      int bar_h = (i + 1) * 3;
      int bx = x + (i * 4);
      int by = y + 12 - bar_h;
      if (i < bars) {
        u8g2->drawBox(bx, by, 3, bar_h);
      } else {
        u8g2->drawFrame(bx, by, 3, bar_h);
      }
    }
  }

  /**
   * Draw high-contrast flashing alarm badge with icon.
   */
  static void drawAlarmBadge(U8G2 *u8g2, int x, int y, int w, int h, const unsigned char *icon, const char *text, bool invert) {
    if (invert) {
      u8g2->drawRBox(x, y, w, h, 3);
      u8g2->setDrawColor(0);
      if (icon) u8g2->drawXBMP(x + 3, y + (h - 16) / 2, 16, 16, icon);
      u8g2->setFont(u8g2_font_helvB10_tr);
      u8g2->drawStr(x + 22, y + h - 4, text);
      u8g2->setDrawColor(1);
    } else {
      u8g2->drawRFrame(x, y, w, h, 3);
      if (icon) u8g2->drawXBMP(x + 3, y + (h - 16) / 2, 16, 16, icon);
      u8g2->setFont(u8g2_font_helvB10_tr);
      u8g2->drawStr(x + 22, y + h - 4, text);
    }
  }
};
